## configs/sipeed_maixsense_defconfig
```kconfig
CONFIG_ARM=y
CONFIG_ARCH_SUNXI=y
CONFIG_DEFAULT_DEVICE_TREE="sun50i-r329-maixsense"
CONFIG_SPL=y
CONFIG_MACH_SUN50I_R329=y
CONFIG_MMC0_CD_PIN="PF6"
# CONFIG_SYS_MALLOC_CLEAR_ON_INIT is not set
```
